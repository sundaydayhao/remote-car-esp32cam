## main/Kconfig.projbuild
```kconfig
menu "Smart Camera Car Configuration"

    menu "Wi-Fi AP"
        config CAR_WIFI_AP_SSID
            string "AP SSID"
            default "ESP32S3-Car"

        config CAR_WIFI_AP_PASSWORD
            string "AP password"
            default "12345678"
            help
                WPA/WPA2 password. Use at least 8 characters, or leave empty for an open AP.

        config CAR_WIFI_AP_CHANNEL
            int "AP channel"
            default 6
            range 1 13

        config CAR_WIFI_MAX_STA
            int "Max connected stations"
            default 4
            range 1 8
    endmenu

    menu "Camera"
        config CAR_CAM_PIN_PWDN
            int "PWDN GPIO (-1 disables)"
            default -1
            range -1 48

        config CAR_CAM_PIN_RESET
            int "RESET GPIO (-1 disables)"
            default -1
            range -1 48

        config CAR_CAM_PIN_XCLK
            int "XCLK GPIO"
            default 15
            range 0 48

        config CAR_CAM_PIN_SIOD
            int "SIOD/SDA GPIO"
            default 4
            range 0 48

        config CAR_CAM_PIN_SIOC
            int "SIOC/SCL GPIO"
            default 5
            range 0 48

        config CAR_CAM_PIN_D7
            int "D7/Y9 GPIO"
            default 16
            range 0 48

        config CAR_CAM_PIN_D6
            int "D6/Y8 GPIO"
            default 17
            range 0 48

        config CAR_CAM_PIN_D5
            int "D5/Y7 GPIO"
            default 18
            range 0 48

        config CAR_CAM_PIN_D4
            int "D4/Y6 GPIO"
            default 12
            range 0 48

        config CAR_CAM_PIN_D3
            int "D3/Y5 GPIO"
            default 10
            range 0 48

        config CAR_CAM_PIN_D2
            int "D2/Y4 GPIO"
            default 8
            range 0 48

        config CAR_CAM_PIN_D1
            int "D1/Y3 GPIO"
            default 9
            range 0 48

        config CAR_CAM_PIN_D0
            int "D0/Y2 GPIO"
            default 11
            range 0 48

        config CAR_CAM_PIN_VSYNC
            int "VSYNC GPIO"
            default 6
            range 0 48

        config CAR_CAM_PIN_HREF
            int "HREF GPIO"
            default 7
            range 0 48

        config CAR_CAM_PIN_PCLK
            int "PCLK GPIO"
            default 13
            range 0 48

        config CAR_CAM_XCLK_FREQ_HZ
            int "XCLK frequency"
            default 20000000
            range 10000000 24000000

        choice CAR_CAMERA_FRAME_SIZE
            prompt "Default stream frame size"
            default CAR_CAMERA_FRAME_SIZE_QVGA

            config CAR_CAMERA_FRAME_SIZE_QQVGA
                bool "QQVGA 160x120"

            config CAR_CAMERA_FRAME_SIZE_QVGA
                bool "QVGA 320x240"

            config CAR_CAMERA_FRAME_SIZE_VGA
                bool "VGA 640x480"
        endchoice

        config CAR_CAMERA_JPEG_QUALITY
            int "JPEG quality, lower is better"
            default 12
            range 5 35

        config CAR_CAMERA_FB_COUNT
            int "Frame buffer count"
            default 2
            range 1 3
    endmenu

    menu "Motor Driver"
        config CAR_MOTOR_LEFT_PWM_GPIO
            int "Left motor PWM GPIO"
            default 14
            range 0 48

        config CAR_MOTOR_LEFT_IN1_GPIO
            int "Left motor IN1 GPIO"
            default 1
            range 0 48

        config CAR_MOTOR_LEFT_IN2_GPIO
            int "Left motor IN2 GPIO"
            default 2
            range 0 48

        config CAR_MOTOR_RIGHT_PWM_GPIO
            int "Right motor PWM GPIO"
            default 21
            range 0 48

        config CAR_MOTOR_RIGHT_IN1_GPIO
            int "Right motor IN1 GPIO"
            default 39
            range 0 48

        config CAR_MOTOR_RIGHT_IN2_GPIO
            int "Right motor IN2 GPIO"
            default 40
            range 0 48

        config CAR_MOTOR_STBY_GPIO
            int "Motor standby GPIO (-1 disables)"
            default 41
            range -1 48

        config CAR_MOTOR_PWM_FREQ_HZ
            int "Motor PWM frequency"
            default 1000
            range 100 20000

        config CAR_MOTOR_DEFAULT_SPEED
            int "Default speed percent"
            default 60
            range 0 100

        config CAR_MOTOR_FAILSAFE_MS
            int "Motor failsafe timeout ms"
            default 900
            range 200 5000

        config CAR_MOTOR_INVERT_LEFT
            bool "Invert left motor direction"
            default n

        config CAR_MOTOR_INVERT_RIGHT
            bool "Invert right motor direction"
            default n
    endmenu

    menu "Ultrasonic Obstacle Avoidance"
        config CAR_ENABLE_ULTRASONIC
            bool "Enable HC-SR04"
            default y

        config CAR_ULTRASONIC_TRIG_GPIO
            int "TRIG GPIO"
            default 42
            range 0 48
            depends on CAR_ENABLE_ULTRASONIC

        config CAR_ULTRASONIC_ECHO_GPIO
            int "ECHO GPIO"
            default 47
            range 0 48
            depends on CAR_ENABLE_ULTRASONIC

        config CAR_OBSTACLE_STOP_CM
            int "Stop distance cm"
            default 20
            range 5 200
            depends on CAR_ENABLE_ULTRASONIC

        config CAR_ULTRASONIC_PERIOD_MS
            int "Measure period ms"
            default 120
            range 60 1000
            depends on CAR_ENABLE_ULTRASONIC
    endmenu

    menu "Audio Intercom"
        config CAR_ENABLE_INTERCOM
            bool "Enable phone/car audio intercom"
            default y
            help
                Adds a /audio WebSocket for 16 kHz mono PCM audio. The car uploads
                microphone audio after a simple noise gate, and plays binary PCM
                frames received from the phone on the speaker.

        config CAR_AUDIO_SAMPLE_RATE_HZ
            int "Audio sample rate"
            default 16000
            range 8000 48000
            depends on CAR_ENABLE_INTERCOM

        config CAR_AUDIO_FRAME_MS
            int "Audio frame size ms"
            default 20
            range 10 100
            depends on CAR_ENABLE_INTERCOM

        choice CAR_AUDIO_MIC_BITS
            prompt "I2S microphone sample width"
            default CAR_AUDIO_MIC_32BIT
            depends on CAR_ENABLE_INTERCOM

            config CAR_AUDIO_MIC_16BIT
                bool "16-bit PCM microphone"

            config CAR_AUDIO_MIC_32BIT
                bool "32-bit I2S microphone, e.g. INMP441"
        endchoice

        config CAR_AUDIO_MIC_SHIFT_BITS
            int "32-bit microphone right shift to PCM16"
            default 16
            range 8 24
            depends on CAR_ENABLE_INTERCOM && CAR_AUDIO_MIC_32BIT
            help
                INMP441-style I2S microphones usually send valid audio left aligned
                in a 32-bit slot. Shift by 16 to convert to signed PCM16.

        config CAR_AUDIO_MIC_RIGHT_SLOT
            bool "Use right I2S microphone slot"
            default n
            depends on CAR_ENABLE_INTERCOM
            help
                INMP441 L/R tied to GND normally uses the left slot. Enable this if
                the microphone L/R pin is tied high.

        config CAR_AUDIO_MIC_BCLK_GPIO
            int "Microphone BCLK/SCK GPIO"
            default 35
            range 0 48
            depends on CAR_ENABLE_INTERCOM

        config CAR_AUDIO_MIC_WS_GPIO
            int "Microphone WS/LRCL GPIO"
            default 36
            range 0 48
            depends on CAR_ENABLE_INTERCOM

        config CAR_AUDIO_MIC_DIN_GPIO
            int "Microphone SD/DOUT to ESP32 DIN GPIO"
            default 37
            range 0 48
            depends on CAR_ENABLE_INTERCOM

        config CAR_AUDIO_SPK_BCLK_GPIO
            int "Speaker amp BCLK GPIO"
            default 38
            range 0 48
            depends on CAR_ENABLE_INTERCOM

        config CAR_AUDIO_SPK_WS_GPIO
            int "Speaker amp LRC/WS GPIO"
            default 45
            range 0 48
            depends on CAR_ENABLE_INTERCOM

        config CAR_AUDIO_SPK_DOUT_GPIO
            int "Speaker amp DIN/DOUT GPIO"
            default 46
            range 0 48
            depends on CAR_ENABLE_INTERCOM

        config CAR_AUDIO_NOISE_GATE_THRESHOLD
            int "Car-side noise gate threshold"
            default 700
            range 0 32767
            depends on CAR_ENABLE_INTERCOM
            help
                Mean absolute PCM16 level. Audio below this level is treated as
                background noise and is not uploaded to the phone.

        config CAR_AUDIO_NOISE_HANGOVER_MS
            int "Noise gate hangover ms"
            default 260
            range 0 2000
            depends on CAR_ENABLE_INTERCOM

        config CAR_AUDIO_WS_MAX_PENDING
            int "Max pending phone audio frames"
            default 4
            range 1 16
            depends on CAR_ENABLE_INTERCOM

        config CAR_AUDIO_MAX_INCOMING_BYTES
            int "Max phone-to-car PCM frame bytes"
            default 4096
            range 256 8192
            depends on CAR_ENABLE_INTERCOM

        config CAR_AUDIO_PLAY_QUEUE_DEPTH
            int "Speaker playback queue depth"
            default 8
            range 1 32
            depends on CAR_ENABLE_INTERCOM

        config CAR_AUDIO_TASK_STACK_SIZE
            int "Audio task stack size"
            default 4096
            range 3072 8192
            depends on CAR_ENABLE_INTERCOM
    endmenu

    config CAR_STATUS_LED_GPIO
        int "Status LED GPIO (-1 disables)"
        default 48
        range -1 48

endmenu
```

## remote_controller/main/Kconfig.projbuild
```kconfig
menu "Remote Controller Configuration"

    menu "Car Wi-Fi"
        config REMOTE_CAR_WIFI_SSID
            string "Car AP SSID"
            default "ESP32CAM-Car"

        config REMOTE_CAR_WIFI_PASSWORD
            string "Car AP password"
            default "12345678"

        config REMOTE_CAR_BASE_URL
            string "Car HTTP base URL"
            default "http://192.168.4.1"

        config REMOTE_WIFI_RECONNECT_MS
            int "Wi-Fi reconnect period ms"
            default 2000
            range 500 10000
    endmenu

    menu "Control"
        config REMOTE_CONTROL_PERIOD_MS
            int "Control update period ms"
            default 80
            range 20 500

        config REMOTE_HEARTBEAT_PERIOD_MS
            int "Heartbeat period ms"
            default 1000
            range 250 5000

        config REMOTE_JOYSTICK_DEADZONE_PERCENT
            int "Joystick deadzone percent"
            default 12
            range 0 40

        config REMOTE_MIN_DRIVE_SPEED
            int "Minimum non-zero drive speed percent"
            default 25
            range 0 100

        config REMOTE_INVERT_DRIVE_X
            bool "Invert drive joystick X"
            default n

        config REMOTE_INVERT_DRIVE_Y
            bool "Invert drive joystick Y"
            default y

        config REMOTE_INVERT_CAMERA_X
            bool "Invert camera joystick X"
            default n

        config REMOTE_INVERT_CAMERA_Y
            bool "Invert camera joystick Y"
            default y
    endmenu

    menu "Joystick GPIO"
        config REMOTE_DRIVE_JOY_X_GPIO
            int "Drive joystick X ADC GPIO (-1 disables)"
            default 34
            range -1 39

        config REMOTE_DRIVE_JOY_Y_GPIO
            int "Drive joystick Y ADC GPIO (-1 disables)"
            default 35
            range -1 39

        config REMOTE_DRIVE_JOY_BUTTON_GPIO
            int "Drive joystick button GPIO (-1 disables)"
            default 32
            range -1 39

        config REMOTE_CAMERA_JOY_X_GPIO
            int "Camera joystick X ADC GPIO (-1 disables)"
            default 36
            range -1 39

        config REMOTE_CAMERA_JOY_Y_GPIO
            int "Camera joystick Y ADC GPIO (-1 disables)"
            default 39
            range -1 39

        config REMOTE_CAMERA_JOY_BUTTON_GPIO
            int "Camera joystick button GPIO (-1 disables)"
            default 33
            range -1 39

        config REMOTE_ESTOP_BUTTON_GPIO
            int "Emergency stop button GPIO (-1 disables)"
            default 25
            range -1 39
    endmenu

    menu "TFT Display Reserved Pins"
        config REMOTE_TFT_ENABLED
            bool "Enable TFT display task placeholder"
            default y

        config REMOTE_TFT_WIDTH
            int "TFT width"
            default 480
            range 1 1024

        config REMOTE_TFT_HEIGHT
            int "TFT height"
            default 320
            range 1 1024

        config REMOTE_TFT_BACKLIGHT_GPIO
            int "TFT backlight GPIO (-1 disables)"
            default -1
            range -1 39
    endmenu

    menu "Audio Reserved Pins"
        config REMOTE_AUDIO_ENABLED
            bool "Enable audio client placeholder"
            default n

        config REMOTE_AUDIO_SAMPLE_RATE_HZ
            int "Audio sample rate"
            default 16000
            range 8000 48000
            depends on REMOTE_AUDIO_ENABLED
    endmenu

endmenu
```

## remote_controller/sdkconfig.defaults
```kconfig
CONFIG_IDF_TARGET="esp32"
CONFIG_ESPTOOLPY_FLASHSIZE_4MB=y
CONFIG_PARTITION_TABLE_SINGLE_APP_LARGE=y
CONFIG_ESP_HTTP_CLIENT_ENABLE_HTTPS=n
CONFIG_FREERTOS_HZ=1000
CONFIG_LOG_DEFAULT_LEVEL_INFO=y
```
